ENTRY(_start)
_start = 0xff000;
SECTIONS { . = 0xff000; .text : { *(.text) } }
gpio_set = 0x1da3e6;
spi_cfg = 0x1dce12;
spi_tx8_sync = 0x1dce5e;
spi_tx16_sync = 0x1dce82;
post_task = 0x1dcd8c;
task_drain = 0x1dcfb2;
lcd_xfer_post_and_wait = 0x20e5e6;
lcd_task0_exec = 0x20e688;
lcd_write = 0x20eb6a;
lcd_flush = 0x20e7f0;
lcd_play_init_table = 0x20ec38;
lcd_render_screen = 0x20e8ee;
kbd_isr_body = 0x1d492e;
kbd_scan = 0x20f932;
kbd_read_matrix = 0x1d4952;
menu_state_get = 0x16fdb2;
menu_window_handler_16fc1e = 0x16fc1e;
main_menu_visibility_loop = 0x16e950;
menu_any_subitem_visible = 0x16e8c6;
main_menu_pred_netzdienste = 0x16f0be;
devmenu_select_dispatch = 0x181b80;
main_menu_table = 0x2ae8fa;
key_raw_code_table = 0x2b7c8c;
gpio_pin_table = 0x2b58de;
st7789_init_casil = 0x2b7a5c;
st7789_init_yes2 = 0x2b7ad5;
st7789_init_yes3 = 0x2b7b4d;
st7789_init_yes = 0x2b7bc5;
interrupt_vector_table = 0x2c11b4;
free_flash_payload_area = 0x2c1244;
kbd_row_bits = 0x875678;
kbd_col_bits = 0x875679;
menu_state_ptr = 0x87546c;
ui_state_ptr = 0x875434;
current_task_id = 0x801837;
lcd_row_offset = 0x8753a0;
panel_variant_flags = 0x874630;
key_event_queue = 0x874dee;
SPI_CTRL = 0xff4940;
SPI_TX = 0xff4942;
SPI_CTRL1 = 0xff4948;
WATCHDOG = 0xff4c00;
KBD_INT_STATUS = 0xff49b6;
